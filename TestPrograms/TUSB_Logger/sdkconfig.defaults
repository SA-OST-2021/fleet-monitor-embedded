## TestPrograms/TUSB_Logger/sdkconfig.defaults
```kconfig
CONFIG_TINYUSB=y
CONFIG_TINYUSB_CDC_ENABLED=y
CONFIG_USB_CDC_ENABLED=y

CONFIG_ESP_CONSOLE_UART_NONE=y
CONFIG_CONSOLE_UART_DEFAULT=n
CONFIG_CONSOLE_UART_CUSTOM=n
CONFIG_CONSOLE_UART=n
```
